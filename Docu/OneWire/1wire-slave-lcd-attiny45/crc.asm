/**
 * functions for calculating crc8 (X^8+X^5+X^4+1) and crc16 (X^16+X^15+X^2+1)
 * 
 * The functions uses constant tables for lokkup and calculation. Alternative
 * use "#define CRC_COMPUTE" to use complete calculation and not include constants.
 * That saves 768 bytes PROGMEM.
 * 
 * ----------------------------------------------------------------------------------
 * 
 * Copyright (C) 2009 runlevel3 GmbH
 * 
 * ----------------------------------------------------------------------------------
 * 
 * LICENSE:
 * 
 * This file is part of AVR-projects.
 * 
 * AVR-projects is free software; you can redistribute it and/or modify
 * it under the terms of the GNU General Public License as published by
 * the Free Software Foundation; either version 2 of the License, or
 * (at your option) any later version.
 * 
 * AVR-projects is distributed in the hope that it will be useful,
 * but WITHOUT ANY WARRANTY; without even the implied warranty of
 * MERCHANTABILITY or FITNESS FOR A PARTICULAR PURPOSE.  See the
 * GNU General Public License for more details.
 * 
 * You should have received a copy of the GNU General Public License
 * along with AVR-projects; if not, write to the Free Software
 * Foundation, Inc., 51 Franklin St, Fifth Floor, Boston, MA  02110-1301  USA
 * 
 * ----------------------------------------------------------------------------------
 * 
 * AVR Assembler 2
 * 
 * ----------------------------------------------------------------------------------
 * 
 * @copyright 2009 runlevel3 GmbH
 * @license   http://www.gnu.org/licenses/gpl.txt GNU General Public License v2
 * @link      http://www.runlevel3.de runlevel3
 **/



;register definitions
#ifndef	TMP_REGS
#define	TMP_REGS
.def	tmp0		= R24
.def	tmp1		= R25
#endif
#ifndef	TMP2_REGS
#define	TMP2_REGS
.def	tmp2		= R22
.def	tmp3		= R23
#endif


.dseg

crc8_data:		.byte	1

crc16_data_l:	.byte	1

crc16_data_h:	.byte	1



.cseg										;Code-Segment

#ifdef	CRC_COMPUTE

;compute crc of data in tmp0, return crc8_data
crc8:
		push	tmp1						;save register
		push	tmp0						;save data
		ldi		tmp1,8						;loop counter
crc8_loop:
		push	tmp1						;save loopcounter
		lds		tmp1,crc8_data				;load old crc
    	eor		tmp1,tmp0					;tmp = ((crc8_data ^ w1_data) & 1);
		ror		tmp1
		lds		tmp1,crc8_data				;load old crc
		brcc	crc8_tmp_0
		push	tmp0						;save data
		ldi		tmp0,0x18
		eor		tmp1,tmp0
		pop		tmp0
crc8_tmp_0:
		ror		tmp1
		sts		crc8_data,tmp1
		lsr		tmp0
		pop		tmp1
		dec		tmp1						;dec loopcounter
		brne	crc8_loop
		pop		tmp0
		pop		tmp1
		ret

;compute crc16 of data in tmp0, return crc16:crc16+1
crc16:
		push	tmp2						;save register
		push	tmp1
		push	tmp0						;save data
		ldi		tmp1,8						;loop counter
crc16_loop:
		push	tmp1						;save loop counter
		ror		tmp0						;shift input data
		push	tmp0						;save data
		ldi		tmp1,1						;for bit complement
		lds		tmp0,crc16_data_l
		brcc	crc16_in_0
		eor		tmp0,tmp1					;complement bit0 
crc16_in_0:
		clc									;for ror into crc_h
		lds		tmp1,crc16_data_h
		sbrs	tmp0,0
		rjmp	crc16_shift
		sec									;for ror into crc_h
		ldi		tmp2,1<<1
		eor		tmp0,tmp2
		ldi		tmp2,1<<6
		eor		tmp1,tmp2
crc16_shift:
		ror		tmp1
		ror		tmp0
		sts		crc16_data_l,tmp0			;save new crc
		sts		crc16_data_h,tmp1
		pop		tmp0						;restore data
		pop		tmp1
		dec		tmp1						;dec loopcounter
		brne	crc16_loop
		pop		tmp0
		pop		tmp1
		pop		tmp2
		ret

#else										;CRC_COMPUTE

;compute crc of data in tmp0, return tmp0 and crc8_data
crc8:
		push	ZL
		push	ZH
		push	tmp1
		push	tmp0						;save data
		lds		tmp1,crc8_data
		eor		tmp0,tmp1					;compute table index
		ldi		ZL,LOW(2*crc8_table)		;load rom storage address
		ldi		ZH,HIGH(2*crc8_table)
		clr		tmp1						;for adc
		add		ZL,tmp0						;and add to pointer
		adc		ZH,tmp1
		lpm		tmp0,Z						;load precomputed crc from table
		sts		crc8_data,tmp0				;and store crc
		pop		tmp0
		pop		tmp1
		pop		ZH
		pop		ZL
		ret

crc8_table:
		.db		0x00, 0x5e, 0xbc, 0xe2, 0x61, 0x3f, 0xdd, 0x83
		.db		0xc2, 0x9c, 0x7e, 0x20, 0xa3, 0xfd, 0x1f, 0x41
		.db		0x9d, 0xc3, 0x21, 0x7f, 0xfc, 0xa2, 0x40, 0x1e
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		.db		0xb6, 0xe8, 0x0a, 0x54, 0xd7, 0x89, 0x6b, 0x35

		
;compute crc16 of data in tmp0, return crc16_data_h:crc16_data_l
crc16:
		push	ZL
		push	ZH
		push	tmp1
		push	tmp0						;save data
		lds		tmp1,crc16_data_l			;load old crc low
		eor		tmp0,tmp1					;compute index
		push	tmp0						;save index
		ldi		ZL,LOW(2*crc16_table_low)	;load rom storage address
		ldi		ZH,HIGH(2*crc16_table_low)
		clr		tmp1						;for adc
		add		ZL,tmp0						;and add to pointer
		adc		ZH,tmp1
		lpm		tmp0,Z
		lds		tmp1,crc16_data_h			;load old crc high
		eor		tmp0,tmp1					;compute crc low
		sts		crc16_data_l,tmp0			;save crc low
		ldi		ZL,LOW(2*crc16_table_high)	;load rom storage address
		ldi		ZH,HIGH(2*crc16_table_high)
		pop		tmp0						;restore index
		clr		tmp1						;for adc
		add		ZL,tmp0						;and add to pointer
		adc		ZH,tmp1
		lpm		tmp0,Z
		sts		crc16_data_h,tmp0			;save crc h
		pop		tmp0
		pop		tmp1
		pop		ZH
		pop		ZL
		ret

crc16_table_low:
		.db		0x00, 0xc1, 0x81, 0x40, 0x01, 0xc0, 0x80, 0x41
		.db		0x01, 0xc0, 0x80, 0x41, 0x00, 0xc1, 0x81, 0x40
		.db		0x01, 0xc0, 0x80, 0x41, 0x00, 0xc1, 0x81, 0x40
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		.db		0x01, 0xc0, 0x80, 0x41, 0x00, 0xc1, 0x81, 0x40
crc16_table_high:
		.db		0x00, 0xc0, 0xc1, 0x01, 0xc3, 0x03, 0x02, 0xc2
		.db		0xc6, 0x06, 0x07, 0xc7, 0x05, 0xc5, 0xc4, 0x04
		.db		0xcc, 0x0c, 0x0d, 0xcd, 0x0f, 0xcf, 0xce, 0x0e
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		.db		0x82, 0x42, 0x43, 0x83, 0x41, 0x81, 0x80, 0x40

#endif										;CRC_COMPUTE


crc_cseg_end:								;cseg end address
